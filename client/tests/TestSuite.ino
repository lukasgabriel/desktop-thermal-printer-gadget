// All Tests


// SHARP DISPLAY SETUP
#include <Adafruit_GFX.h>
#include <Adafruit_SharpMem.h>

#define SHARP_SCK 10
#define SHARP_MOSI 12
#define SHARP_SS 11

Adafruit_SharpMem display(SHARP_SCK, SHARP_MOSI, SHARP_SS, 400, 240);

#define BLACK 0
#define WHITE 1
#define MAX_LINE_LENGTH 32

int minorHalfSize;

void SharpInit() {
  Serial.println("Initializing SHARP display...");
  display.begin();
  display.clearDisplay();

  minorHalfSize = min(display.width(), display.height()) / 2;

  display.setRotation(0);
  display.clearDisplay();

  //display.setTextWrap(false);
  display.setTextSize(2);
  display.setTextColor(BLACK);
  display.setCursor(5, 5);
  display.println("Hello, world!");

  display.refresh();
}

void printBoth(char* val) {
  display.clearDisplay();
  display.setCursor(5, 5);
  Serial.println(val);
  display.println(val);
  display.refresh();
}
// ----------


// BUTTON TEST
#define switchL 3
#define switchM 0
#define switchR 1

void ButtonTest() {
  bool lWorks = false;
  bool mWorks = false;
  bool rWorks = false;

  pinMode(LED_BUILTIN, OUTPUT);
  pinMode(switchL, INPUT);
  pinMode(switchM, INPUT);
  pinMode(switchR, INPUT);

  digitalWrite(LED_BUILTIN, HIGH);

  printBoth("Running Button Test to test Interface Button Functionality...");
  printBoth("Please press all 3 Buttons to proceed. Tests will continue once all buttons have been pressed.");

  while (!(lWorks && mWorks && rWorks)) {
    if ((digitalRead(switchL) == HIGH) && !lWorks) {
      printBoth("Button L Pressed");
      lWorks = true;
    }
    if ((digitalRead(switchM) == HIGH) && !mWorks) {
      printBoth("Button M Pressed");
      mWorks = true;
    }
    if ((digitalRead(switchR) == HIGH) && !rWorks) {
      printBoth("Button R Pressed");
      rWorks = true;
    }
  }
  digitalWrite(LED_BUILTIN, LOW);
  printBoth("All Button Presses were registered! Continuing...");
}
// ---------


// LED TEST
#include <Adafruit_NeoPixel.h>
#define ledPIN 6
#define NUMPIXELS 1
Adafruit_NeoPixel pixels(NUMPIXELS, ledPIN, NEO_GRB + NEO_KHZ800);

void LEDTest() {
  printBoth("Running LED Test to test Indicator LED Functionality.");

  printBoth("First Loop: RED -> GREEN -> BLUE");

  int rVal = 0;
  int gVal = 0;
  int bVal = 0;
  printBoth("Increasing RED Value...");
  while (rVal < 255) {
    rVal++;
    pixels.setPixelColor(0, pixels.Color(gVal, rVal, bVal));
    pixels.show();
    delay(5);
  }
  printBoth("Increasing GREEN Value...");
  while (gVal < 255) {
    gVal++;
    pixels.setPixelColor(0, pixels.Color(gVal, rVal, bVal));
    pixels.show();
    delay(5);
  }
  printBoth("Increasing BLUE Value...");
  while (bVal < 255) {
    bVal++;
    pixels.setPixelColor(0, pixels.Color(gVal, rVal, bVal));
    pixels.show();
    delay(5);
  }

  printBoth("Second Loop: BLUE -> RED -> GREEN");

  rVal = 0;
  gVal = 0;
  bVal = 0;
  printBoth("Increasing BLUE Value...");
  while (bVal < 255) {
    bVal++;
    pixels.setPixelColor(0, pixels.Color(gVal, rVal, bVal));
    pixels.show();
    delay(5);
  }
  printBoth("Increasing RED Value...");
  while (rVal < 255) {
    rVal++;
    pixels.setPixelColor(0, pixels.Color(gVal, rVal, bVal));
    pixels.show();
    delay(5);
  }
  printBoth("Increasing GREEN Value...");
  while (gVal < 255) {
    gVal++;
    pixels.setPixelColor(0, pixels.Color(gVal, rVal, bVal));
    pixels.show();
    delay(5);
  }

  printBoth("Third Loop: GREEN -> BLUE -> RED");

  rVal = 0;
  gVal = 0;
  bVal = 0;
  printBoth("Increasing GREEN Value...");
  while (gVal < 255) {
    gVal++;
    pixels.setPixelColor(0, pixels.Color(gVal, rVal, bVal));
    pixels.show();
    delay(5);
  }
  printBoth("Increasing BLUE Value...");
  while (bVal < 255) {
    bVal++;
    pixels.setPixelColor(0, pixels.Color(gVal, rVal, bVal));
    pixels.show();
    delay(5);
  }
  printBoth("Increasing RED Value...");
  while (rVal < 255) {
    rVal++;
    pixels.setPixelColor(0, pixels.Color(gVal, rVal, bVal));
    pixels.show();
    delay(5);
  }

  pixels.clear();
  pixels.show();
  printBoth("LED Test finished. Continuing...");
}
// ---------


// PIEZO TEST
#include <ezBuzzer.h>
const int BUZZER_PIN = 2;
int noteLength;
ezBuzzer buzzer(BUZZER_PIN);
int melody[] = {
  NOTE_E5, NOTE_E5, NOTE_E5,
  NOTE_E5, NOTE_E5, NOTE_E5,
  NOTE_E5, NOTE_G5, NOTE_C5, NOTE_D5,
  NOTE_E5,
  NOTE_F5, NOTE_F5, NOTE_F5, NOTE_F5,
  NOTE_F5, NOTE_E5, NOTE_E5, NOTE_E5, NOTE_E5,
  NOTE_E5, NOTE_D5, NOTE_D5, NOTE_E5,
  NOTE_D5, NOTE_G5
};
int noteDurations[] = {
  8, 8, 4,
  8, 8, 4,
  8, 8, 8, 8,
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  4, 4
};
void PiezoTest() {
  printBoth("Running Piezo Test to test Piezo Buzzer functionality.");
  printBoth("Buzzer should play a melody...");

  noteLength = sizeof(noteDurations) / sizeof(int);
  int i = 2;
  while (i > 0) {
    buzzer.loop();
    if (buzzer.getState() == BUZZER_IDLE) {
      buzzer.playMelody(melody, noteDurations, noteLength);
      i--;
    }
  }
  buzzer.stop();

  printBoth("Piezo Test finished. Continuing...");
}
// ---------


// NOKIA DISPLAY TEST
#include <SPI.h>
#include "LCD_Functions.h"
char xkcdSandwich[] = {
  0xFF,
  0x8D,
  0x9F,
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  0xFF,
};
char sparkfunLogo[] = {
  0x00, 0x00, 0x00, 0x00, 0x00, 0x00, 0x00, 0x00, 0x00, 0x00, 0x00, 0x00,  // (0,0)->(11,7) ~ These 12 bytes cover an 8x12 block in the left corner of the display
  0x00, 0x00, 0x00, 0x00, 0x00, 0x00, 0x00, 0x00, 0x00, 0x00, 0x00, 0x00,  // (12,0)->(23,7)
  0x00, 0x00, 0x00, 0x00, 0x00, 0x00, 0x00, 0x00, 0x00, 0x00, 0x00, 0xE0,  // (24,0)->(35,7)
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  0x00, 0x00, 0x00, 0x00, 0x00, 0x00, 0x00, 0x00, 0x00, 0x00, 0x00, 0x00,  // (72,40)->(83,47) !!! The bottom right pixel!
};
void NokiaTest() {
  printBoth("Running LCD Test to test LCD Display Functionality.");

  printBoth("Initializing Display on SPI0 (Testbench right)...");
  lcdBegin(0);
  delay(500);

  printBoth("Displaying Image on D0...");
  setBitmap(sparkfunLogo);
  updateDisplay(0);
  delay(500);

  printBoth("Setting D0 Contrast to 20...");
  setContrast(20, 0);
  delay(500);

  printBoth("Setting D0 Contrast to 40...");
  setContrast(20, 0);
  delay(500);

  printBoth("Setting D0 Contrast to 60...");
  setContrast(20, 0);
  delay(500);

  printBoth("Displaying Text on D0...");
  setStr("The quick brown fox jumped over the lazy dog. 0123456789!@#$%^&*()_+", 0, 0, true);
  updateDisplay(0);
  delay(500);

  printBoth("Dimming backlight on D0...");
  for (int i = 255; i >= 0; i -= 5) {
    analogWrite(blPin0, i);
    delay(20);
  }


  printBoth("Initializing Display on SPI1 (Testbench left)...");
  lcdBegin(1);
  delay(500);

  printBoth("Displaying Image on D1...");
  setBitmap(sparkfunLogo);
  updateDisplay(1);
  delay(500);

  printBoth("Setting D1 Contrast to 20...");
  setContrast(20, 1);
  delay(500);

  printBoth("Setting D1 Contrast to 40...");
  setContrast(20, 1);
  delay(500);

  printBoth("Setting D1 Contrast to 60...");
  setContrast(20, 1);
  delay(500);

  printBoth("Displaying Text on D1...");
  setStr("The quick brown fox jumped over the lazy dog. 0123456789!@#$%^&*()_+", 0, 0, true);
  updateDisplay(1);
  delay(500);

  printBoth("Dimming backlight on D1...");
  for (int i = 255; i >= 0; i -= 5) {
    analogWrite(blPin1, i);
    delay(20);
  }


  printBoth("LCD Test finished. Continuing...");
}
// ----------


// THERMAL PRINTER TEST
#include "Adafruit_Thermal.h"
#include "tests/test_lena.h"
#include "tests/adaqrcode.h"
#include "SoftwareSerial.h"
#define TX_PIN 8
#define RX_PIN 9
#define CTS_PIN 7
SoftwareSerial mySerial(RX_PIN, TX_PIN);
Adafruit_Thermal printer(&mySerial, CTS_PIN);
void PrinterTest() {
  printBoth("Running Printer Test to test Thermal Printer Functionality.");
  printBoth("Initializing Printer on UART1...");

  mySerial.begin(9600);
  printer.begin();

  // Font options
  printer.setFont('B');
  printBoth("Printing Text B ...");
  printer.println("FontB");
  printer.println("ABCDEFGHIJKLMNOPQRSTUVWXYZ");

  printer.setFont('A');
  printBoth("Printing Text A ...");
  printer.println("FontA (default)");
  printer.println("ABCDEFGHIJKLMNOPQRSTUVWXYZ");

  // Test inverse on & off
  printer.inverseOn();
  printBoth("Printing INVERSE Text ...");
  printer.println(F("Inverse ON"));
  printer.inverseOff();

  // Test character double-height on & off
  printer.doubleHeightOn();
  printBoth("Printing DOUBLE Height Text ...");
  printer.println(F("Double Height ON"));
  printer.doubleHeightOff();

  // Set text justification (right, center, left) -- accepts 'L', 'C', 'R'
  printer.justify('R');
  printBoth("Printing RIGHT justified Text ...");
  printer.println(F("Right justified"));
  printer.justify('C');
  printBoth("Printing CENTER justified Text ...");
  printer.println(F("Center justified"));
  printer.justify('L');
  printBoth("Printing LEFT justified Text ...");
  printer.println(F("Left justified"));

  // Test more styles
  printer.boldOn();
  printBoth("Printing BOLD Text ...");
  printer.println(F("Bold text"));
  printer.boldOff();

  printer.underlineOn();
  printBoth("Printing UNDERLINED Text ...");
  printer.println(F("Underlined text"));
  printer.underlineOff();

  printer.setSize('L');  // Set type size, accepts 'S', 'M', 'L'
  printBoth("Printing LARGE Text ...");
  printer.println(F("Large"));
  printer.setSize('M');
  printBoth("Printing MEDIUM Text ...");
  printer.println(F("Medium"));
  printer.setSize('S');
  printBoth("Printing SMALL Text ...");
  printer.println(F("Small"));

  printer.justify('C');
  printBoth("Printing NORMALSPACE Text ...");
  printer.println(F("normal\nline\nspacing"));
  printer.setLineHeight(50);
  printBoth("Printing TALLSPACE Text ...");
  printer.println(F("Taller\nline\nspacing"));
  printer.setLineHeight();  // Reset to default
  printer.justify('L');

  // Barcode examples:
  // CODE39 is the most common alphanumeric barcode:
  printBoth("Printing CODE39 Barcode ...");
  printer.printBarcode("ADAFRUT", CODE39);
  printer.setBarcodeHeight(100);
  // Print UPC line on product barcodes:
  printBoth("Printing UPC_A Barcode ...");
  printer.printBarcode("123456789123", UPC_A);

  // Print the 75x75 pixel logo in adalogo.h:
  printBoth("Printing Test BITMAP ...");
  printer.printBitmap(512, 512, lena_gray);

  // Print the 135x135 pixel QR code in adaqrcode.h:
  printBoth("Printing QR Code ...");
  printer.printBitmap(adaqrcode_width, adaqrcode_height, adaqrcode_data);

  printBoth("Printer Tests DONE!");
  printer.println(F("DONE!  :)"));

  printBoth("Feeding 6 LINES ...");
  printer.feed(6);

  printer.sleep();       // Tell printer to sleep
  delay(3000L);          // Sleep for 3 seconds
  printer.wake();        // MUST wake() before printing again, even if reset
  printer.setDefault();  // Restore printer to defaults

  printBoth("Printer Test finished. Continuing...");
}
// ----------


// WiFi & MQTT TEST

// ----------


void setup() {
  Serial.begin(9600);
  Serial.println("Hello World!");
  pixels.begin();
  SharpInit();
}

void loop() {
  printBoth("Beginning Test Suite of all components.");

  ButtonTest();
  delay(1000);

  LEDTest();
  delay(1000);

  PiezoTest();
  delay(1000);

  NokiaTest();
  delay(1000);

  PrinterTest();
  delay(1000);

  printBoth("Test Suite finished. Restarting in 5 Seconds. Builtin LED will light up when the first test is ready.");
  delay(5000);
}